## boards/arm/npcm400f_evb/npcm400f_evb_defconfig
```kconfig
#
# Copyright (c) 2023 Nuvoton Technology Corporation.
#
# SPDX-License-Identifier: Apache-2.0
#

CONFIG_SOC_NPCM400F=y
CONFIG_SOC_SERIES_NPCM400F=y
CONFIG_BOARD_NPCM400F_EVB=y

CONFIG_SRAM_VECTOR_TABLE=y
# General Kernel Options
CONFIG_SYS_CLOCK_HW_CYCLES_PER_SEC=48000000
CONFIG_XIP=y
CONFIG_STACK_SENTINEL=y
# [main stack size default: 1024]
CONFIG_MAIN_STACK_SIZE=4096
CONFIG_NO_OPTIMIZATIONS=y
CONFIG_HEAP_MEM_POOL_SIZE=16384

# subsystem
CONFIG_LOG=y
CONFIG_LOG_BACKEND_UART=y
# [log buffer size range: 128-65536]
CONFIG_LOG_BUFFER_SIZE=65536

# Clock Driver
CONFIG_CLOCK_CONTROL=y
CONFIG_CLOCK_CONTROL_NPCM4XX=y

# UART Driver
CONFIG_SERIAL=y
CONFIG_UART_INTERRUPT_DRIVEN=y
CONFIG_UART_NPCM4XX=y

# Pinmux Driver
CONFIG_PINMUX=y
CONFIG_PINMUX_NPCM4XX=y
CONFIG_PINCTRL_STRING_NAME=y

# GPIO Driver
CONFIG_GPIO=y
CONFIG_GPIO_NPCM4XX=y

# Console Driver
CONFIG_CONSOLE=y
CONFIG_UART_CONSOLE=y

# Watchdog Driver
CONFIG_WATCHDOG=y
CONFIG_WDT_NPCM4XX=y

# MIWU Driver
CONFIG_NPCM4XX_MIWU=y

# PECI driver
#CONFIG_PECI=y
#CONFIG_PECI_NPCM4XX=y

#Counter Driver
CONFIG_COUNTER=y
CONFIG_COUNTER_NPCM4XX=y

# SPIM Driver
CONFIG_FLASH=y
CONFIG_SPI=y
CONFIG_SPI_NOR_MULTI_DEV=y
CONFIG_SPI_NPCM4XX_SPIM=y

# FIU Driver
CONFIG_FLASH=y
CONFIG_SPI=y
CONFIG_SPI_NOR_MULTI_DEV=y
CONFIG_SPI_NPCM4XX_FIU=y

# ESPI Driver
CONFIG_ESPI=y

# IPMI Driver
CONFIG_IPMI=y
CONFIG_IPMI_KCS_NPCM4XX=y

# I2C Driver
CONFIG_I2C_NPCM4XX=y
CONFIG_I2C=y

#ADC Driver
CONFIG_ADC=y
CONFIG_ADC_NPCM4XX=y

#SPIP Driver
CONFIG_SPI=y
CONFIG_SPIP_NPCM4XX=y

# I3C driver
#CONFIG_I3C=y
#CONFIG_I3C_NPCM4XX=y

# USB Driver
CONFIG_USB=y
CONFIG_USB_DC_NPCM4XX=y

# JTAG Driver
CONFIG_JTAG=y
CONFIG_JTAG_SHELL=y
CONFIG_JTAG_NPCM4XX=y
```

## drivers/i2c/slave/Kconfig.ipmb
```kconfig
# I2C IPMB Slave configuration options

# Copyright (c) 2023 Zephyr
# SPDX-License-Identifier: Apache-2.0

config I2C_IPMB_SLAVE
	bool "I2C Slave IPMB driver"
	default n
	help
	  Enable virtual I2C Slave IPMB driver
```

## drivers/i3c/Kconfig
```kconfig
# I3C options

menuconfig I3C
	bool "I3C Drivers"
	help
	  Enable I3C Driver.

if I3C

config I3C_SHELL
	bool "Enable I3C Shell"
	default y
	depends on SHELL
	select SHELL_GETOPT
	help
	  Enable I3C Shell.

module = I3C
module-str = i3c
source "subsys/logging/Kconfig.template.log_config"

source "drivers/i3c/slave/Kconfig"

# Include these first so that any properties (e.g. defaults) below can be
# overridden (by defining symbols in multiple locations)
source "drivers/i3c/Kconfig.npcm4xx"
endif # I3C
```

## drivers/jtag/Kconfig.npcm4xx
```kconfig
# NPCM4XX JTAG driver configuration options

# Copyright (c) 2023 Nuvoton Technology Inc.
# SPDX-License-Identifier: Apache-2.0

config JTAG_NPCM4XX
	bool "NPCM4XX JTAG driver"
	depends on SOC_FAMILY_NPCM4XX
	help
	  This option enables the JTAG driver for NPCM4XX family of
	  processors.
	  Say y if you wish to use JTAG channels on NPCM4XX MCU.
```

## drivers/spi/Kconfig.npcm4xx_fiu
```kconfig
# NPCM4XX SPI-FIU Driver configuration options

# Copyright (c) 2023 Nuvoton Technology Corporation.
# SPDX-License-Identifier: Apache-2.0

config SPI_NPCM4XX_FIU
	bool "Nuvoton NPCM4XX SPI driver for NOR flash"
	default y
	depends on SOC_FAMILY_NPCM4XX
	help
	  Enable the SPI driver for NPCM4XX family of processors. This driver is
	  for the dedicated SPI controller (FIU) to access the NOR flash.

config SPI_NPCM4XX_FIU_DIRECT_WRITE
	bool "Nuvoton NPCM4XX SPI driver for Direct Write to NOR flash"
	default n
	depends on SPI_NPCM4XX_FIU
	help
	  Enable the SPI driver to use direct write to access NOR flash.
```

## drivers/spi/Kconfig.npcm4xx_spim
```kconfig
# NPCM4XX SPI-SPIM Driver configuration options

# Copyright (c) 2023 Nuvoton Technology Corporation.
# SPDX-License-Identifier: Apache-2.0

config SPI_NPCM4XX_SPIM
	bool "Nuvoton NPCM4XX SPIM driver for internal flash"
	default y
	depends on SOC_FAMILY_NPCM4XX
	help
	  Enable the SPIM driver for NPCM4XX family of processors. This driver is
	  for the dedicated SPI controller (SPIM) to access the internal flash.
```

## dts/bindings/i2c/zephyr,i2c-ipmb.yaml
```yaml
#
# Copyright (c) Zephyr
#
# SPDX-License-Identifier: Apache-2.0
#

description: Zephyr I2C IPMB device

compatible: "zephyr,i2c-ipmb"

include: i2c-device.yaml

properties:
    size:
      type: int
      required: true
      description: Total IPMB page size
```

## dts/bindings/i3c/i3c-controller.yaml
```yaml
# Copyright (c) 2023 Nuvoton Technology Corporation.
# SPDX-License-Identifier: Apache-2.0

include: base.yaml

bus: i3c

properties:
    label:
      required: true
    i2c-scl-hz:
      required: false
      type: int
      default: 1000000
      description: I2C mode SCL frequency in HZ

    i3c-scl-hz:
      required: false
      type: int
      default: 12500000
      description: I3C Push-Pull mode SCL frequency in HZ
```

## dts/bindings/i3c/nuvoton,npcm4xx-i3c.yaml
```yaml
# Copyright (c) 2023 Nuvoton Technology Corporation.
# SPDX-License-Identifier: Apache-2.0

description: NUVOTON I3C

compatible: "nuvoton,npcm4xx-i3c"

include: [i3c-controller.yaml, nuvoton-pinctrl.yaml]

properties:
  instance-id:
    required: true
    type: int
    description: |
      Instance ID of the device, used to specify port number

  slave:
    required: false
    type: boolean
    description: Initialized as slave (default) / master

  secondary:
    required: false
    type: boolean
    description: Initialized as a secondary master

  assigned-address:
    required: true
    type: int
    description: |
      The default address of the device

  part-id:
    required: false
    type: int
    description: |
      PID[31:16], used for bus enumeration with entdaa

  vendor-def-id:
    required: false
    type: int
    description: |
      PID[11:0], used for bus enumeration with entdaa

  bcr:
    required: false
    type: int
    description: |
      Bus Characteristics Register, used for bus enumeration with entdaa

  dcr:
    required: false
    type: int
    description: |
      Device Characteristics Register, used for bus enumeration with entdaa

  busno:
    required: true
    type: int
    description: |
      Bus Number, used for bus enumeration

  pinctrl-0:
    type: phandles
    required: true
    description: configurations of pinmux controllers

#  extra-gpios:
#    type: phandle-array
#    required: false
#    description: |
#      Used to add the extra info to identify different BIC by GPIOs.

  ibi-append-pec:
    required: false
    type: boolean
    description: |
      Append PEC byte to the IBI data.

  priv-xfer-pec:
    required: false
    type: boolean
    description: |
      Enable this option in slave mode if the i3c want to communicate with data that have PEC.
      The PEC will auto append to the tail of the data when doing private transfer and verify
      the PEC when receiving the data from master.

#  pid-extra-info:
#    required: false
#    type: int
#    description: |
#      Extra information of the PID Bits[11:0]. Use to identify the different BIC.
#      If extra-gpios exist, the extra pid will be replaced by the value of extra-gpios.
```

## dts/bindings/jtag/nuvoton,npcm4xx-jtag.yaml
```yaml
description: NPCM4XX family JTAG

compatible: "nuvoton,npcm4xx-jtag"

include: base.yaml

properties:
    use-spi:
      type: int
      required: true
      description: |
        Use spi pins to service jtag signal.
    tck-gpios:
      type: phandle-array
      required: true
      description: |
        Use to service jtag tck signal.
    tdi-gpios:
      type: phandle-array
      required: true
      description: |
        Use to service jtag tdi signal.
    tdo-gpios:
      type: phandle-array
      required: true
      description: |
        Use to service jtag tdo signal.
    tms-gpios:
      type: phandle-array
      required: true
      description: |
        Use to service jtag tms signal.
```

## dts/bindings/spi/nuvoton,npcm4xx-spi-spim.yaml
```yaml
# Copyright (c) 2023 Nuvoton Technology Corporation.
# SPDX-License-Identifier: Apache-2.0

description: Nuvoton, NPCM4XX-SPI-SPIM controller node

compatible: "nuvoton,npcm4xx-spi-spim"

include: ["spi-controller.yaml"]

properties:
  reg:
    required: true
  clocks:
    required: true
  spi-ctrl-caps-mask:
    type: int
    required: false
    description: |
      SPI flash controller mode/protocol capability configuration.

      bit 0 : disable 1-1-1
      bit 1 : disable 1-1-1 (fast read)
      bit 8 : disable 1-1-2
      bit 9 : disable 1-2-2
      bit 10: disable 2-2-2
      bit 16: disable 1-1-4
      bit 17: disable 1-4-4
      bit 18: disable 4-4-4
```

## dts/bindings/spi/nuvoton,npcm4xx-spip.yaml
```yaml
# Copyright (c) 2023 Nuvoton Technology Corporation.
# SPDX-License-Identifier: Apache-2.0

description: Nuvoton, NPCM4XX-SPIP controller node

compatible: "nuvoton,npcm4xx-spip"

include: ["spi-controller.yaml", "nuvoton-pinctrl.yaml"]

properties:
  reg:
    required: true
  clocks:
    required: true
  spi-ctrl-caps-mask:
    type: int
    required: false
    description: |
      SPI flash controller mode/protocol capability configuration.

      bit 0 : disable 1-1-1
      bit 1 : disable 1-1-1 (fast read)
      bit 8 : disable 1-1-2
      bit 9 : disable 1-2-2
      bit 10: disable 2-2-2
      bit 16: disable 1-1-4
      bit 17: disable 1-4-4
      bit 18: disable 4-4-4
```
